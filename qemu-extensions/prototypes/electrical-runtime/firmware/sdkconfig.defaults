## qemu-extensions/prototypes/electrical-runtime/firmware/sdkconfig.defaults
```kconfig
CONFIG_IDF_TARGET_ESP32S3=y
CONFIG_ESPTOOLPY_FLASHSIZE_4MB=y
CONFIG_ESP_CONSOLE_UART_DEFAULT=y
CONFIG_ESP_MAIN_TASK_STACK_SIZE=4096
```

## tests/firmware/cpu_lifecycle_counter/sdkconfig.defaults
```kconfig
CONFIG_IDF_TARGET_ESP32S3=y
CONFIG_ESPTOOLPY_FLASHSIZE_4MB=y
CONFIG_ESP_CONSOLE_UART_DEFAULT=y
CONFIG_ESP_MAIN_TASK_STACK_SIZE=4096
CONFIG_ESP_DEFAULT_CPU_FREQ_MHZ_240=y
CONFIG_ESP_INT_WDT=n
CONFIG_ESP_TASK_WDT_EN=n
CONFIG_BOOTLOADER_WDT_ENABLE=n
CONFIG_FREERTOS_UNICORE=n
```

## tests/firmware/i2c_native/main/Kconfig.projbuild
```kconfig
menu "Native I2C fixture"
choice I2C_NATIVE_PROFILE
    prompt "Expected electrical graph profile (runner must configure graph independently)"
    default I2C_NATIVE_PROFILE_CONNECTED
config I2C_NATIVE_PROFILE_CONNECTED
    bool "Connected SHT21 and EEPROM with external pull-ups"
config I2C_NATIVE_PROFILE_WRONG
    bool "Devices connected to other GPIO pads"
config I2C_NATIVE_PROFILE_DISCONNECTED
    bool "Devices disconnected from master nets"
config I2C_NATIVE_PROFILE_POWER
    bool "Devices unpowered while master nets remain pulled up"
config I2C_NATIVE_PROFILE_NO_PULL
    bool "No internal or external pull-ups"
config I2C_NATIVE_PROFILE_STUCK
    bool "SDA or SCL held low"
config I2C_NATIVE_PROFILE_SLAVE
    bool "Slave receive/request/reset through physical scripted masters"
config I2C_NATIVE_PROFILE_SLAVE_DISCONNECTED
    bool "Slave callbacks remain silent with disconnected physical masters"
config I2C_NATIVE_PROFILE_WIRE
    bool "Native master/slave callbacks on one actual wired bus"
config I2C_NATIVE_PROFILE_WIRE_DEFINED
    bool "Public explicit-operation repeated-start alongside unchanged convenience API"
endchoice
config I2C_NATIVE_SPEED_HZ
    int "Master or external-peer SCL frequency (Hz)"
    range 100000 400000
    default 100000
    help
        Use 100000 or 400000 for standard-mode or fast-mode acceptance runs.
config I2C_NATIVE_SDA0
    int "Controller 0 SDA GPIO"
    range 0 48
    default 8
config I2C_NATIVE_SCL0
    int "Controller 0 SCL GPIO"
    range 0 48
    default 9
config I2C_NATIVE_SDA1
    int "Controller 1 SDA GPIO"
    range 0 48
    default 10
config I2C_NATIVE_SCL1
    int "Controller 1 SCL GPIO"
    range 0 48
    default 11
endmenu
```

## tests/firmware/i2c_native/sdkconfig.defaults
```kconfig
CONFIG_IDF_TARGET_ESP32S3=y
CONFIG_ESPTOOLPY_FLASHSIZE_4MB=y
CONFIG_ESP_CONSOLE_UART_DEFAULT=y
CONFIG_ESP_MAIN_TASK_STACK_SIZE=4096
CONFIG_FREERTOS_HZ=1000
CONFIG_I2C_NATIVE_PROFILE_CONNECTED=y
```

## tests/firmware/interrupt_matrix/sdkconfig.defaults
```kconfig
CONFIG_ESPTOOLPY_FLASHSIZE_4MB=y
CONFIG_ESP_CONSOLE_UART_DEFAULT=y
CONFIG_ESP_MAIN_TASK_STACK_SIZE=8192
CONFIG_FREERTOS_HZ=1000
```

## tests/firmware/lcd_cam_native/main/Kconfig.projbuild
```kconfig
menu "Ordinary LCD CAM native qualification"
choice LCD_CAM_NATIVE_MODE
    prompt "Exclusive GPIO owner"
    default LCD_CAM_NATIVE_I80
config LCD_CAM_NATIVE_I80
    bool "ST7789 I80 internal RAM queued transfers"
config LCD_CAM_NATIVE_RGB
    bool "RGB internal RAM timing and ownership"
config LCD_CAM_NATIVE_CAMERA
    bool "Official OV2640 component"
endchoice
choice LCD_CAM_NATIVE_RGB_MODE
    prompt "RGB buffering mode"
    depends on LCD_CAM_NATIVE_RGB
    default LCD_CAM_NATIVE_RGB_DOUBLE
config LCD_CAM_NATIVE_RGB_DOUBLE
    bool "Two internal RAM frame buffers"
config LCD_CAM_NATIVE_RGB_BOUNCE
    bool "No framebuffer, ISR filled bounce buffers"
config LCD_CAM_NATIVE_RGB_DEMAND
    bool "On demand internal RAM framebuffer"
endchoice
choice LCD_CAM_NATIVE_RGB_BUS
    prompt "RGB physical data bus width"
    depends on LCD_CAM_NATIVE_RGB
    default LCD_CAM_NATIVE_RGB_BUS16
config LCD_CAM_NATIVE_RGB_BUS8
    bool "8 data wires"
config LCD_CAM_NATIVE_RGB_BUS16
    bool "16 data wires"
endchoice
config LCD_CAM_NATIVE_RGB_BUS_WIDTH
    int
    default 8 if LCD_CAM_NATIVE_RGB_BUS8
    default 16
choice LCD_CAM_NATIVE_RGB_PIXEL_FORMAT
    prompt "RGB framebuffer pixel format"
    depends on LCD_CAM_NATIVE_RGB
    default LCD_CAM_NATIVE_RGB_RGB565
config LCD_CAM_NATIVE_RGB_RGB332
    bool "8-bit RGB332 (8-wire bus only)"
    depends on LCD_CAM_NATIVE_RGB_BUS_WIDTH = 8
config LCD_CAM_NATIVE_RGB_RGB565
    bool "16-bit RGB565 little-endian memory bytes"
config LCD_CAM_NATIVE_RGB_RGB888
    bool "24-bit RGB888 R,G,B memory bytes"
endchoice
config LCD_CAM_NATIVE_RGB_PIXEL_BITS
    int
    default 8 if LCD_CAM_NATIVE_RGB_RGB332
    default 24 if LCD_CAM_NATIVE_RGB_RGB888
    default 16
choice LCD_CAM_NATIVE_CAM_FORMAT
    prompt "Camera format"
    depends on LCD_CAM_NATIVE_CAMERA
    default LCD_CAM_NATIVE_CAM_RGB565
config LCD_CAM_NATIVE_CAM_RGB565
    bool "RGB565"
config LCD_CAM_NATIVE_CAM_YUV422
    bool "YUV422"
config LCD_CAM_NATIVE_CAM_JPEG
    bool "JPEG"
endchoice
config LCD_CAM_NATIVE_FB_COUNT
    int "Camera frame buffers"
    range 1 2
    default 1
config LCD_CAM_NATIVE_SLOW_MS
    int "Hold each camera buffer before returning, milliseconds"
    range 0 5000
    default 0
config LCD_CAM_NATIVE_FAULT
    int "Camera fault: 0 none, 1 PWDN truncation, 2 reset then reinitialize"
    range 0 2
    default 0
config LCD_CAM_NATIVE_FAULT_DELAY_MS
    int "Delay after GET_BEGIN before physical PWDN/reset assertion"
    range 1 1000
    default 7
config LCD_CAM_NATIVE_PSRAM
    bool "Request initialized external PSRAM consumer buffers"
    default n
endmenu
```

## tests/firmware/lcd_cam_native/sdkconfig.defaults
```kconfig
CONFIG_IDF_TARGET_ESP32S3=y
CONFIG_ESPTOOLPY_FLASHSIZE_4MB=y
CONFIG_ESP_CONSOLE_UART_DEFAULT=y
CONFIG_ESP_MAIN_TASK_STACK_SIZE=8192
CONFIG_FREERTOS_HZ=1000
CONFIG_OV2640_SUPPORT=y
CONFIG_SCCB_HARDWARE_I2C_DRIVER_NEW=y
CONFIG_CAMERA_JPEG_MODE_FRAME_SIZE_CUSTOM=y
CONFIG_CAMERA_JPEG_MODE_FRAME_SIZE=16384
# CONFIG_SPIRAM is not set
# CONFIG_CAMERA_PSRAM_DMA is not set
```

## tests/firmware/memory_native/sdkconfig.defaults
```kconfig
CONFIG_ESPTOOLPY_FLASHSIZE_4MB=y
CONFIG_ESP_CONSOLE_UART_DEFAULT=y
CONFIG_ESP_MAIN_TASK_STACK_SIZE=8192
CONFIG_COMPILER_OPTIMIZATION_PERF=y
# CONFIG_SPIRAM is not set
CONFIG_PARTITION_TABLE_CUSTOM=y
CONFIG_PARTITION_TABLE_CUSTOM_FILENAME="partitions.csv"
```

## tests/firmware/pulse_native/main/Kconfig.projbuild
```kconfig
menu "Native pulse fixture"
choice PULSE_NATIVE_WIRING
    prompt "Physical project wiring"
    default PULSE_NATIVE_CONNECTED
config PULSE_NATIVE_CONNECTED
    bool "Connected GPIO4 to GPIO5 and GPIO6 to GPIO8"
config PULSE_NATIVE_DISCONNECTED
    bool "Disconnected inputs held by explicit project pulldowns"
config PULSE_NATIVE_WRONG_WIRE
    bool "PCNT wired to inactive GPIO3, capture wired to MCPWM B GPIO7"
endchoice
choice PULSE_NATIVE_FEATURE
    prompt "Feature to exercise"
    default PULSE_NATIVE_ALL
config PULSE_NATIVE_ALL
    bool "All pulse features"
config PULSE_NATIVE_LEDC_PCNT
    bool "LEDC with physical PCNT input"
config PULSE_NATIVE_MCPWM
    bool "MCPWM timer/operator/capture/sync/brake"
config PULSE_NATIVE_SDM
    bool "SDM density and allocation"
endchoice
config PULSE_NATIVE_ADC_PROVIDER_READY
    bool "Run actual ADC conversion (requires externally qualified native ADC provider)"
    default n
    help
        Enable only after the native ADC controller/provider is READY. The runner
        requires --adc-provider-ready evidence JSON; absence is UNAVAILABLE,
        never a fake conversion or a failure hidden as a passing ADC test.
endmenu
```

## tests/firmware/pulse_native/sdkconfig.defaults
```kconfig
CONFIG_IDF_TARGET_ESP32S3=y
CONFIG_ESPTOOLPY_FLASHSIZE_4MB=y
CONFIG_ESP_CONSOLE_UART_DEFAULT=y
CONFIG_ESP_MAIN_TASK_STACK_SIZE=8192
CONFIG_FREERTOS_HZ=1000
CONFIG_PULSE_NATIVE_CONNECTED=y
CONFIG_PULSE_NATIVE_ALL=y
```

## tests/firmware/radio_init/sdkconfig.defaults
```kconfig
CONFIG_ESPTOOLPY_FLASHSIZE_4MB=y
CONFIG_ESP_CONSOLE_UART_DEFAULT=y
CONFIG_ESP_MAIN_TASK_STACK_SIZE=8192
CONFIG_BT_ENABLED=y
CONFIG_BT_BLUEDROID_ENABLED=y
CONFIG_BT_BLE_ENABLED=y
CONFIG_LOG_DEFAULT_LEVEL_INFO=y
```

## tests/firmware/rmt_native/main/Kconfig.projbuild
```kconfig
menu "Native RMT fixture"
choice RMT_NATIVE_PROFILE
    prompt "External v3 graph expectation"
    default RMT_NATIVE_PROFILE_CONNECTED
config RMT_NATIVE_PROFILE_CONNECTED
    bool "GPIO4 to GPIO5 and GPIO6 to GPIO7 connected"
config RMT_NATIVE_PROFILE_DISCONNECTED
    bool "Both TX pads disconnected from RX pads"
endchoice
endmenu
```

## tests/firmware/spi_native/main/Kconfig.projbuild
```kconfig
menu "Native SPI ordinary driver qualification"
choice SPI_NATIVE_PROFILE
    prompt "Expected independently supplied v3 electrical graph"
    default SPI_NATIVE_PROFILE_CONNECTED
config SPI_NATIVE_PROFILE_CONNECTED
    bool "Two NOR devices per bus"
config SPI_NATIVE_PROFILE_LOOPBACK
    bool "External MOSI-to-MISO graph wire (no NOR)"
config SPI_NATIVE_PROFILE_WRONG_CS
    bool "NOR CS disconnected from firmware CS (strict pause expected)"
config SPI_NATIVE_PROFILE_DISCONNECTED_MISO
    bool "NOR MISO disconnected from firmware MISO (strict pause expected)"
config SPI_NATIVE_PROFILE_OWNER_ERROR
    bool "SPI3 direct RX owner error (strict pause expected)"
endchoice
config SPI_NATIVE_NEGATIVE_HOST
    int "Controller targeted by strict-pause negative profile"
    range 2 3
    default 2
config SPI_NATIVE_SPEED_HZ
    int "SCLK frequency"
    range 100000 1000000
    default 1000000
endmenu
```

## tests/firmware/uart_native/arduino/sdkconfig.defaults
```kconfig
CONFIG_IDF_TARGET_ESP32S3=y
CONFIG_UART_NATIVE_PROFILE_ARDUINO=y
CONFIG_ESPTOOLPY_FLASHSIZE_4MB=y
CONFIG_ESP_CONSOLE_UART_DEFAULT=y
CONFIG_ESP_MAIN_TASK_STACK_SIZE=8192
CONFIG_AUTOSTART_ARDUINO=y
CONFIG_ARDUINO_VARIANT="esp32s3"
CONFIG_FREERTOS_HZ=1000
# Ordinary HardwareSerial physical UART fixture; reuse pinned selective core.
CONFIG_ARDUINO_SELECTIVE_COMPILATION=y
# CONFIG_AUTOCONNECT_WIFI is not set
# CONFIG_ARDUINO_SELECTIVE_SPI is not set
# CONFIG_ARDUINO_SELECTIVE_Wire is not set
# CONFIG_ARDUINO_SELECTIVE_ESP_SR is not set
# CONFIG_ARDUINO_SELECTIVE_ESP_Video is not set
# CONFIG_ARDUINO_SELECTIVE_EEPROM is not set
# CONFIG_ARDUINO_SELECTIVE_Preferences is not set
# CONFIG_ARDUINO_SELECTIVE_Ticker is not set
# CONFIG_ARDUINO_SELECTIVE_Update is not set
# CONFIG_ARDUINO_SELECTIVE_Zigbee is not set
# CONFIG_ARDUINO_SELECTIVE_FS is not set
# CONFIG_ARDUINO_SELECTIVE_SD is not set
# CONFIG_ARDUINO_SELECTIVE_SD_MMC is not set
# CONFIG_ARDUINO_SELECTIVE_SPIFFS is not set
# CONFIG_ARDUINO_SELECTIVE_FFat is not set
# CONFIG_ARDUINO_SELECTIVE_LittleFS is not set
# CONFIG_ARDUINO_SELECTIVE_Network is not set
# CONFIG_ARDUINO_SELECTIVE_Ethernet is not set
# CONFIG_ARDUINO_SELECTIVE_PPP is not set
# CONFIG_ARDUINO_SELECTIVE_Hash is not set
# CONFIG_ARDUINO_SELECTIVE_ArduinoOTA is not set
# CONFIG_ARDUINO_SELECTIVE_AsyncUDP is not set
# CONFIG_ARDUINO_SELECTIVE_DNSServer is not set
# CONFIG_ARDUINO_SELECTIVE_ESPmDNS is not set
# CONFIG_ARDUINO_SELECTIVE_HTTPClient is not set
# CONFIG_ARDUINO_SELECTIVE_Matter is not set
# CONFIG_ARDUINO_SELECTIVE_NetBIOS is not set
# CONFIG_ARDUINO_SELECTIVE_WebServer is not set
# CONFIG_ARDUINO_SELECTIVE_WiFi is not set
# CONFIG_ARDUINO_SELECTIVE_NetworkClientSecure is not set
# CONFIG_ARDUINO_SELECTIVE_WiFiProv is not set
# CONFIG_ARDUINO_SELECTIVE_BLE is not set
# CONFIG_ARDUINO_SELECTIVE_BluetoothSerial is not set
# CONFIG_ARDUINO_SELECTIVE_SimpleBLE is not set
# CONFIG_ARDUINO_SELECTIVE_RainMaker is not set
# CONFIG_ARDUINO_SELECTIVE_OpenThread is not set
# CONFIG_ARDUINO_SELECTIVE_Insights is not set
```

## tests/firmware/uart_native/main/Kconfig.projbuild
```kconfig
menu "Ordinary native UART fixture"
choice UART_NATIVE_PROFILE
    prompt "Physical wiring expectation"
    default UART_NATIVE_PROFILE_CONNECTED
config UART_NATIVE_PROFILE_CONNECTED
    bool "Crossed UART1/2 and physical UART0 loopback"
config UART_NATIVE_PROFILE_ABSENT
    bool "UART2 driver absent; UART1 has no responding peer"
config UART_NATIVE_PROFILE_DISCONNECTED
    bool "UART1/2 data wires disconnected"
config UART_NATIVE_PROFILE_WRONG
    bool "UART1/2 TX wired to non-receiver pads"
config UART_NATIVE_PROFILE_UHCI
    bool "Ordinary UART1 UHCI/GDMA full duplex with real UART2 peer"
endchoice
endmenu
```
